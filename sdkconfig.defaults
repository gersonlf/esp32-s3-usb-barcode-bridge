## sdkconfig.defaults
```kconfig
# Bluetooth LE usando NimBLE
CONFIG_BT_ENABLED=y
CONFIG_BT_NIMBLE_ENABLED=y
CONFIG_BT_NIMBLE_ROLE_PERIPHERAL=y
CONFIG_BT_NIMBLE_ROLE_BROADCASTER=y
CONFIG_BT_NIMBLE_MAX_CONNECTIONS=1
CONFIG_BT_NIMBLE_MAX_BONDS=3
CONFIG_BT_NIMBLE_MAX_CCCDS=8
CONFIG_BT_NIMBLE_NVS_PERSIST=y
CONFIG_BT_NIMBLE_SECURITY_ENABLE=y
CONFIG_BT_NIMBLE_SM_LEGACY=y
CONFIG_BT_NIMBLE_SM_SC=y
CONFIG_BT_NIMBLE_SM_LVL=2
CONFIG_BT_NIMBLE_SVC_GAP_DEVICE_NAME="Leitor QR ESP32"
CONFIG_BT_NIMBLE_SVC_GAP_APPEARANCE=0x03C1
CONFIG_BT_NIMBLE_GAP_DEVICE_NAME_MAX_LEN=31
CONFIG_BT_NIMBLE_SVC_GAP_PPCP_MIN_CONN_INTERVAL=12
CONFIG_BT_NIMBLE_SVC_GAP_PPCP_MAX_CONN_INTERVAL=24
CONFIG_BT_NIMBLE_SVC_GAP_PPCP_SLAVE_LATENCY=30
CONFIG_BT_NIMBLE_SVC_GAP_PPCP_SUPERVISION_TMO=200

# O ESP32-S3-N16R8 possui 16 MB de flash. PSRAM não é necessária para este projeto.
CONFIG_ESPTOOLPY_FLASHSIZE_16MB=y

CONFIG_BT_NIMBLE_HID_SERVICE=y
CONFIG_PARTITION_TABLE_SINGLE_APP_LARGE=y
```
